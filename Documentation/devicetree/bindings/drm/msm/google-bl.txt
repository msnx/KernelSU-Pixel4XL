## Documentation/devicetree/bindings/regulator/tps-regulator.txt
```
TPS fixed voltage regulators

Required properties:
- compatible: Must be "regulator-tps".
- nr-control-gpios: the number of gpios involved in controlling the
  regulator.
- control-gpios: list of phandles for the control gpio.
- gpio-enable-sequence - gpio indexes for enabling the regulator.
- gpio-enable-delay - delays in microseconds, if any, after turning on
  each gpio in gpio-enable-sequence. 0 if no delay.
- gpio-disable-sequence - gpio indexes for disabling the regulator.
- gpio-disable-delay - delays in microseconds, if any, after turning off
  each gpio in gpio-disable-sequence. 0 if no delay.

Any property defined as part of the core regulator
binding, defined in regulator.txt, can also be used.
However a fixed voltage regulator is expected to have the
regulator-min-microvolt and regulator-max-microvolt
to be the same.

Example:
        regulator@00{
                compatible = "regulator-tps";
                regulator-name = "ext_5v_boost";
                nr-control-gpios = <3>;
                control-gpios = <&tlmm 146 GPIO_ACTIVE_HIGH>,
                                <&tlmm 66 GPIO_ACTIVE_HIGH>,
                                <&tlmm 118 GPIO_ACTIVE_HIGH>;
                gpio-enable-sequence = <1 2 3>;
                gpio-enable-delay = <1000 100 300>;
                gpio-disable-sequence = <2 3 1>;
                gpio-disable-delay = <0 0 0>;
                status = "okay";
        };
```

## Documentation/devicetree/bindings/soc/qcom/modemsmem.txt
```
modemsmem (Modem Shared Memory) Driver

The modemsmem driver is used to notify with modem subsystem about
hardware and software information via SMD channel.

Required properties:

- compatible: name of the component used for driver matching, should be:
              "modemsmem"

Example:
    modemsmem {
        compatible = "modemsmem";
    };
```

## drivers/char/oscar/Kconfig
```kconfig
menu "Gasket devices"

config GASKET_FRAMEWORK
	tristate "Gasket framework"
	depends on PCI && (X86_64 || ARM64)
	help
	  This framework supports Gasket-compatible devices, such as Apex and
	  Oscar.  It is required for any of the following module(s).

	  To compile this driver as a module, choose M here.  The module
	  will be called "gasket".

config OSCAR_DRIVER
        tristate "Oscar Driver"
        depends on GASKET_FRAMEWORK && MFD_ABC_PCIE && AIRBRUSH_DRAM && AIRBRUSH_SM
        help
          This driver supports the Oscar device.  Say Y if you want to
          include this driver in the kernel.

          To compile this driver as a module, choose M here.  The module
          will be called "oscar".

endmenu
```

## drivers/clk/airbrush/Kconfig
```kconfig
config COMMON_CLK_AIRBRUSH
	bool
	default n
	---help---
	airbrush common clock driver selection
```

## drivers/input/misc/lm36011/Kconfig
```kconfig
#
# LM36011 led laser drivers configuration
#
menu "Led laser support"

config INPUT_LM36011
	tristate "Lm36011 led laser support"
	help
	  If you say yes here you get support for lm36011 led laser.

endmenu
```

## drivers/input/misc/vd6281/Kconfig
```kconfig
#
# Miscellaneous I2C chip drivers configuration
#
menu "STMicro rainbow sensor support"

config INPUT_VD6281
	tristate "STMicro vd6281 rainbow sensor support"
	help
	  If you say yes here you get support for STMicro vd6281 rainbow sensor.

endmenu
```

## drivers/input/touchscreen/synaptics_dsx_v27/Kconfig
```kconfig
#
# Synaptics DSX touchscreen driver configuration
#
menuconfig TOUCHSCREEN_SYNAPTICS_DSX_v27
	bool "Synaptics DSX touchscreen"
	default y
	help
	  Say Y here if you have a Synaptics DSX touchscreen connected
	  to your system.

	  If unsure, say N.

if TOUCHSCREEN_SYNAPTICS_DSX_v27

choice
	default TOUCHSCREEN_SYNAPTICS_DSX_I2C_v27
	prompt "Synaptics DSX bus interface"
config TOUCHSCREEN_SYNAPTICS_DSX_I2C_v27
	bool "RMI over I2C"
	depends on I2C
config TOUCHSCREEN_SYNAPTICS_DSX_SPI_v27
	bool "RMI over SPI"
	depends on SPI_MASTER
config TOUCHSCREEN_SYNAPTICS_DSX_RMI_HID_I2C_v27
	bool "HID over I2C"
	depends on I2C
endchoice

config TOUCHSCREEN_SYNAPTICS_DSX_CORE_v27
	tristate "Synaptics DSX core driver module"
	depends on I2C || SPI_MASTER
	help
	  Say Y here to enable basic touch reporting functionality.

	  If unsure, say N.

	  To compile this driver as a module, choose M here: the
	  module will be called synaptics_dsx_core.

config TOUCHSCREEN_SYNAPTICS_DSX_RMI_DEV_v27
	tristate "Synaptics DSX RMI device module"
	depends on TOUCHSCREEN_SYNAPTICS_DSX_CORE_v27
	help
	  Say Y here to enable support for direct RMI register access.

	  If unsure, say N.

	  To compile this driver as a module, choose M here: the
	  module will be called synaptics_dsx_rmi_dev.

config TOUCHSCREEN_SYNAPTICS_DSX_FW_UPDATE_v27
	tristate "Synaptics DSX firmware update module"
	depends on TOUCHSCREEN_SYNAPTICS_DSX_CORE_v27
	help
	  Say Y here to enable support for doing firmware update.

	  If unsure, say N.

	  To compile this driver as a module, choose M here: the
	  module will be called synaptics_dsx_fw_update.

config TOUCHSCREEN_SYNAPTICS_DSX_TEST_REPORTING_v27
	tristate "Synaptics DSX test reporting module"
	depends on TOUCHSCREEN_SYNAPTICS_DSX_CORE_v27
	help
	  Say Y here to enable support for retrieving production test reports.

	  If unsure, say N.

	  To compile this driver as a module, choose M here: the
	  module will be called synaptics_dsx_test_reporting.

config TOUCHSCREEN_SYNAPTICS_DSX_PROXIMITY_v27
	tristate "Synaptics DSX proximity module"
	depends on TOUCHSCREEN_SYNAPTICS_DSX_CORE_v27
	help
	  Say Y here to enable support for proximity functionality.

	  If unsure, say N.

	  To compile this driver as a module, choose M here: the
	  module will be called synaptics_dsx_proximity.

config TOUCHSCREEN_SYNAPTICS_DSX_ACTIVE_PEN_v27
	tristate "Synaptics DSX active pen module"
	depends on TOUCHSCREEN_SYNAPTICS_DSX_CORE_v27
	help
	  Say Y here to enable support for active pen functionality.

	  If unsure, say N.

	  To compile this driver as a module, choose M here: the
	  module will be called synaptics_dsx_active_pen.

config TOUCHSCREEN_SYNAPTICS_DSX_GESTURE_v27
	tristate "Synaptics DSX user defined gesture module"
	depends on TOUCHSCREEN_SYNAPTICS_DSX_CORE_v27
	help
	  Say Y here to enable support for user defined gesture functionality.

	  If unsure, say N.

	  To compile this driver as a module, choose M here: the
	  module will be called synaptics_dsx_gesture.

config TOUCHSCREEN_SYNAPTICS_DSX_VIDEO_v27
	tristate "Synaptics DSX video module"
	depends on TOUCHSCREEN_SYNAPTICS_DSX_CORE_v27
	help
	  Say Y here to enable support for video communication functionality.

	  If unsure, say N.

	  To compile this driver as a module, choose M here: the
	  module will be called synaptics_dsx_video.

config TOUCHSCREEN_SYNAPTICS_DSX_DEBUG_v27
	tristate "Synaptics DSX debug module"
	depends on TOUCHSCREEN_SYNAPTICS_DSX_CORE_v27
	help
	  Say Y here to enable support for firmware debug functionality.

	  If unsure, say N.

	  To compile this driver as a module, choose M here: the
	  module will be called synaptics_dsx_debug.

endif
```

## drivers/media/platform/msm/camera/Kconfig
```kconfig
#
# CAMERA
#

menuconfig CAMERA_FW_UPDATE
	tristate "Qualcomm Technologies, Inc. Camera Firmware Update"
		depends on I2C

menuconfig CAMERA_ACT_READ_LENS
	tristate "Qualcomm Technologies, Inc. Camera Actuator Read Lens function"
		depends on I2C
```

## drivers/media/platform/msm/camera_floral/Kconfig
```kconfig
#
# CAMERA
#

menuconfig CAMERA_FW_UPDATE
	tristate "Qualcomm Technologies, Inc. Camera Firmware Update"
		depends on I2C
```

## drivers/mfd/adnc/Kconfig
```kconfig
#
# Multifunction miscellaneous devices
#

if HAS_IOMEM
menu "Knowles IAxxx Multifunction device drivers"

config MFD_IAXXX
	tristate "Knowles IAxxx Audio Device"
	select REGMAP
	select MFD_CORE
        help
	  This is the MFD core driver for the Knowles IAxxx device

endmenu
endif

if MFD_IAXXX
# IAxxx bus interfaces
config MFD_IAXXX_I2C
	bool "I2C bus-interface"
	select REGMAP_I2C
	depends on I2C
	help
	  Enable I2C Bus interface for IAXXX MFD driver
	  Say Y if I2C support is needed for the IAXXX device

config MFD_IAXXX_SPI
	bool "SPI bus-interface"
	select REGMAP_SPI
	depends on SPI
	help
	  Enable SPI Bus interface for IAXXX MFD driver
	  Say Y if SPI support is needed for the IAXXX device

config MFD_IAXXX_SOUNDWIRE
	bool "SoundWire bus-interface"
	select REGMAP_SWR
	select SOUNDWIRE_WCD_CTRL
	depends on SOUNDWIRE
	help
	  Enable SoundWire Bus interface for IAXXX MFD driver
	  Soundwire bus enable option

config MFD_IAXXX_TUNNEL_POLL
	bool "Tunneling in polling mode"

config MFD_IAXXX_ATHENS_FPGA
        bool "Enable Athens FPGA changes"

config MFD_IAXXX_REGMAP_FPGA
        bool "Enable REGMAP FPGA changes"

config MFD_IAXXX_CUSTOM_CONFIG_ALGO
	bool "Custom configuration for plugins"
config MFD_IAXXX_SENSOR_TUNNEL
	bool "Custom tunnel node for sensor"

config MFD_IAXXX_DISABLE_RUNTIME_PM
	bool "Disable runtime pm"

endif
```

## drivers/misc/airbrush/Kconfig
```kconfig
#
# Airbrush
#

menu "Airbrush"

config AIRBRUSH_SM
	bool "Device driver for Airbrush State Manager"
	default "n"
	---help---
	  This option enables device driver support for airbrush state manager.
	  This includes the support for CLK, LPDDR, UART, SPI and other IP
	  configurations which can be controlled through the PCIe interface.

config AIRBRUSH_SM_DEBUGFS
	depends on AIRBRUSH_SM
	bool "Debugfs entries for Airbrush State Manager"
	default "n"
	---help---
	  This option enables Debugfs entries for airbrush state manager.

config AIRBRUSH_SM_PROFILE
	depends on AIRBRUSH_SM && AIRBRUSH_SM_DEBUGFS
	bool "Profiling support for Airbrush State Manager"
	default "y"
	---help---
	  This option enables profiling support for airbrush state manager.

config AIRBRUSH_SM_DEBUG_IOCTLS
	depends on AIRBRUSH_SM
	bool "Debug ioctls for Airbrush State Manager"
	default "y"
	---help---
	  This option enables debug ioctls for airbrush state manager.

config AB_DDR_MR13_RRO_ENABLE
	depends on AIRBRUSH_SM
	bool "MR13 RRO Enable (4x, 2x refresh)"
	default "n"
	---help---
	  This option enables the MR13 RRO(Refresh Rate Option) (=OP[4]).
	  When this is slected, all the refresh rate options will be enabled
	  from the MR4 OP[2:0] which includes "4x refresh" and "2x refresh".

config AB_DDR_RW_TEST
	depends on AIRBRUSH_SM
	bool "DDR Read/Write test"
	default "y"
	---help---
	  This option enables DDR read/write test functionality. Read/Write
	  test includes Memtester and PCIe DMA read/write test. Please check
	  the drivers/misc/airbrush/airbrush-ddr.h for all the options exposed
	  by this interface.

config AB_DDR_SANITY_TEST
	depends on AB_DDR_RW_TEST
	bool "DDR sanity test during state change"
	default "n"
	---help---
	  This option enables DDR sanity test during state manger state
	  transitions. Sanity test is DDR PCIe dma read/write test which is
	  executed during the ASM state transitions from DDR driver to check
	  the DDR data integrity.

config AB_DDR_SANITY_SZ_MBYTES
	int "Size in Mega Bytes"
	depends on AB_DDR_SANITY_TEST
	default 48
	---help---
	  Defines the size (in MiB) of the memory area for DDR sanity test.
	  Size should be between 1 to 512 MiB. Sanity test always uses
	  0x2000_0000 as base address which is the DRAM base address.

config AB_DDR_EYE_MARGIN
	depends on AB_DDR_RW_TEST
	bool "DDR Eye Margin test"
	default "y"
	---help---
	  This option enables DDR Eye Margin test.

config AB_DDR_PPC
	depends on AIRBRUSH_SM
	bool "DDR Performance Profiling"
	default "y"
	---help---
	  This option enables DDR Performance Profiling functionality.

endmenu
```

## drivers/misc/ipu/Kconfig
```kconfig
#
# Paintbox IPU
#

menu "Paintbox Programmable IPU"

config IPU
	bool "Paintbox IPU Driver"
	default n
	---help---
	  Say Y here if you want to include the Paintbox IPU, aka Pixel Visual
	  Core in the kernel.  The Paintbox IPU is a hardware accelerator for
	  image processing applications.

config IPU_DEBUG
	bool  "Paintbox IPU Debug Support"
	depends on IPU && DEBUG_FS
	default n
	---help---
	This option enables debug support for the Paintbox IPU.
	If you are unsure, say N.

config IPU_AB_MFD_ADAPTER
	bool  "Paintbox Airbrush Multi-function Adapter"
	depends on IPU
	depends on MFD_ABC_PCIE
	default n
	---help---
	This option enables support for IPU hardware on the Airbrush companion
	chip.  If you are unsure, say N.

config IPU_IOMMU_ENABLED
	bool "Set the default state for the Paintbox to off"
	depends on IPU
	depends on IPU_IOMMU
	default n
	---help---
	This option enables support for IPU IOMMU in IPU driver.

config IPU_IOMMU_PAGE_TABLE_ON_AB
	bool "store IPU IOMMU page table in AB dram"
	depends on IPU
	depends on IPU_IOMMU
	default n
	---help---
	this option stores the IPU IOMMU page table in AB memory instead of host memory.

endmenu
```

## drivers/power/supply/google/Kconfig
```kconfig
menuconfig GOOGLE_BMS
	bool "Google, Inc. Charging and Fuel Gauge support"
	help
	  Say Y here to enable Google, Inc. support for Battery and Charging.

if GOOGLE_BMS

config GOOGLE_BATTERY_CHARGING
	tristate "Google Battery and Charging Control"
	select GOOGLE_CHARGER
	select GOOGLE_BATTERY
	help
	  Say Y here to enable new Google Gen Features.
	  This option selects Google Battery and Multi Step Charging enabling
	  new features such as battery controlled charge tables and charge path
	  resistance compensation. New gen features require configuration in
	  device tree.

config GOOGLE_CHARGER
	tristate "Google Multi Step Charging"
	help
	  Say Y here to choose the Google Multi Step Charging control.
	  The driver implements a multi CC-CV steps charging using battery
	  temperature and voltage to set the charger constant charging
	  current and float voltage.

config GOOGLE_BATTERY
	tristate "Google Battery"
	help
	  Say Y here to choose the Google Battery.
	  The driver handles charge tables, recharge threshold, state of charge,
	  battery statistics such as bin count and other features common to all
	  google battery powered devices.

config USB_OVERHEAT_MITIGATION
	tristate "Google USB Overheat Mitigation"
	help
	  Say Y here to enable Google USB overheat mitigation

config GOOGLE_LOGBUFFER
	tristate "debugfs logbuffer"
	help
	  Say Y here to enable logbuffer.
	  This option enables a module that exposes an API to maintain driver
	  specific logs in an exclusive ring buffer and exposes it through
	  debugfs.

endif	# GOOGLE_BMS

config CHARGER_P9221
	tristate "IDT P9221 wireless power receiver driver"
	depends on I2C
	help
	  This driver provides support for the IDT P9221 wireless
	  power receiver.
```

## drivers/staging/s2mpg01/Kconfig
```kconfig
config S2MPG01
	tristate "S2MPG01 regulator MFD"
	depends on I2C
	select REGMAP_I2C
	help
	  This driver controls the S2MPG01 voltage regulator via I2C,
	  as well as GPIO and ADC functionality.
```

## drivers/staging/wlan_mac/Kconfig
```kconfig
#
# google set wlan mac
#
config GOOGLE_WLAN_MAC
	bool "Read MAC from device tree"
	default n
	help
	  Say Y here if you want the GOOGLE WLAN MAC features
```
