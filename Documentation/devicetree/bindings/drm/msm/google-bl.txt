## Documentation/devicetree/bindings/drm/msm/google-bl.txt
```
Google binned low power mode panel

This is an extension of QTI's mdss-dsi-panel to handle additional command
sequences for low power modes.

Required properties:
- compatible:           "google,dsi_binned_lp"


==============================================================

Google low power display modes

Required properties:
- compatible:		"google,lp-modes"
- label:			Name of the entry
- dsi-lp-brightness-threshold:
			Max brightness supported by the mode
- dsi-lp-command:	Command sequence to enter this mode
- dsi-lp-command-state:	Command state used in this mode

Example:

/ {
	...
	google,lp-modes {
		lp-mode@0 {
			label = "off";
			google,dsi-lp-brightness-threshold = <0>;
			google,dsi-lp-command = [
				05 01 00 00 00 00 01 22
			];
			google,dsi-lp-command-state = "dsi_lp_mode";
		};

		lp-mode@1 {
			label = "high";
			google,dsi-lp-brightness-threshold = <255>;
			google,dsi-lp-command = [
				39 01 00 00 00 00 03 51 01 FF
				05 01 00 00 00 00 01 12
			];
			google,dsi-lp-command-state = "dsi_lp_mode";
		};
};

==============================================================

Google high brightness display mode

This is an extension of QTI's mdss-dsi-panel to handle special display modes
that allow for exceptionally high brightness.

High brightness mode (HBM) is specified through 1 or more user brightness
ranges. Conceptually, Each HBM range contains,
1) User brightness threshold
2) Panel brightness range
3) DSI command (optional)

HBM ranges must be sorted by brightness threshold and not overlap.
An HBM range covers user brightness levels starting from the threshold, up to
but not including the next HBM mode's threshold.
The last HBM range covers user brightness levels starting from its threshold,
up to and including qcom,mdss-brightness-max-level.

When user brightness is updated, the appropriate HBM range is selected and the
corresponding DSI command, if present, is sent to the panel. Then the user's
brightness is linearly mapped to the panel's brightness range and the panel is
updated if needed.

Note that there is currently no support for backlight LUTs during HBM mode.

HBM support also includes optional brightness dimming support. Brightness
dimming refers to some panels' ability to gradually change brightness over
time, smoothing the transition between current brightness and the latest
brightness level requested by the host. The driver uses this feature, if
supported by the panel, to smooth brightness changes as HBM is enabled, changes
ranges, or disabled.
To implement this support,
1) HBM range entry sequences (dsi-hbm-range-entry-command) or exit sequences
(dsi-hbm-exit-command) will include commands necessary to enable brightness
dimming
2) The corresponding HBM node will specify the number of frames dimming is
expected to last on the panel side
3) The same node will specify a command to send to the panel at the end of the
brightness dimming duration, to disable brightness dimming.

HBM uses the following properties. Each property is required, unless specified
as optional:
- google,hbm-ranges:	Parent list of HBM ranges.
- hbm-range@n:		An HBM range, starting at n=0.
- dsi-hbm-exit-command: Optional command sequence to exit HBM.
- dsi-hbm-commands-state: Optional command state used for HBM commands.
- dsi-hbm-exit-num-dimming-frames: Optional number of frames indicating
    brightness dimming duration. Mandatory if dsi-hbm-exit-dimming-stop-command
    is specified.
- dsi-hbm-exit-dimming-stop-command: Optional command to send at the end of the
	brightness dimming duration, to disable dimming. Mandatory if
	dsi-hbm-exit-num-dimming-frames is specified.
- dsi-irc-addr: Optional register address to control IRC.
- dsi-irc-bit-offset: Optional IRC bit offset.
- dsi-irc-unlock-command: Optional command for unlock panel IRC.
- dsi-irc-unlock-commands-state: Optional command state for unlock panel IRC.
- dsi-irc-lock-command: Optional command for lock panel IRC.
- dsi-irc-lock-commands-state: Optional command state for lock panel IRC

Each hbm-range@n contains the following properties. Each property is required,
unless specified as optional:
- dsi-hbm-range-brightness-threshold: Starting user brightness for this HBM
    range.
- dsi-hbm-range-entry-command: Optional command sequence to enter this range.
- dsi-hbm-range-commands-state: Optional command state used in this range.
- dsi-hbm-range-bl-min-level: Start of panel brightness range
    (inclusive).
- dsi-hbm-range-bl-max-level: End of panel brightness range (inclusive).
- dsi-hbm-range-num-dimming-frames: Optional. Analogous to
    dsi-hbm-exit-num-dimming-frames, but for a given HBM range.
- dsi-hbm-range-dimming-stop-command: Optional. Analogous to
    dsi-hbm-exit-dimming-stop-command, but for a given HBM range.

Example:

/ {
	...
	google,hbm-ranges {
		google,dsi-hbm-exit-command = [
			15 01 00 00 00 00 02 53 20
		];
		google,dsi-hbm-commands-state = "dsi_lp_mode";

		google,dsi-irc-addr = <0xBE>;
		google,dsi-irc-bit-offset = <21>;
		google,dsi-irc-unlock-command = [
			39 01 00 00 00 00 03 F0 5A 5A
		];
		google,dsi-irc-unlock-commands-state = "dsi_lp_mode";
		google,dsi-irc-lock-command = [
			39 01 00 00 00 00 03 F0 A5 A5
		];
		google,dsi-irc-lock-commands-state = "dsi_lp_mode";

		hbm-range@0 {
			google,dsi-hbm-range-brightness-threshold = <1>;

			google,dsi-hbm-range-bl-min-level = <0x5>;
			google,dsi-hbm-range-bl-max-level = <0x3ff>;
			google,dsi-hbm-range-entry-command = [
				15 01 00 00 00 00 02 53 20
			];
			google,dsi-hbm-range-commands-state = "dsi_lp_mode";
		};

		hbm-range@1 {
			google,dsi-hbm-range-brightness-threshold = <170>;

			google,dsi-hbm-range-bl-min-level = <0x3ff>;
			google,dsi-hbm-range-bl-max-level = <0x3ff>;
			google,dsi-hbm-range-entry-command = [
				15 01 00 00 00 00 02 53 E0
			];
			google,dsi-hbm-range-commands-state = "dsi_lp_mode";
		};
	};
```

## Documentation/devicetree/bindings/misc/abc-sm.txt
```
* abc-sm device-tree bindings

Required properties:
- compatible		: Shall be "abc,airbrush-sm".

- clocks		: A phandle to reference clk.
- clock-names		: Shall be "ab_ref".

- ab-ready-gpio		: A phandle to READY GPIO; ABH output.
- fw-patch-en		: A phandle to FW_PATCH_EN GPIO; ABH input.
- soc-pwrgood-gpio	: A phandle to RESET_N GPIO; ABH input.
- ddr-iso-gpio		: A phandle to DDRCKE_ISO GPIO; ABH input.
- ddr-sr-gpio		: A phandle to DDR_SR GPIO; ABH input.

- pinctrl-names		: Shall be "default".
- pinctrl-0		: List of phandles to pinctrl; they can be on AP,
			  or AP PMIC.

- chip-id		: Shall be "0" for A0 or "1" for B0.

Optional properties:
- ddrcke-iso-clamp-wr	: If present, WR will be applied so that DDRCKE_ISO
			  is clamped before suspend.  This is only needed if
			  the hardware configuration incorrectly caused a
			  backdrive issue.

- otp-bypass		: If present, WR will be applied so that OTP is NOT
			  loaded during cold boot or resume boot.  This is
			  only needed if the OTP values on the hardware
			  configuration are known to be problematic.
```

## Documentation/devicetree/bindings/misc/citadel-spi.txt
```
* Google Inc. Citadel SoC

Required properties:
- compatible: Should contain "google,citadel".
- reg: SPI address for chip
- spi-max-frequency: max SPI frequency supported by the device

Example:
	citadel@0 {
		compatible = "google,citadel";
		reg = <0>;
		spi-max-frequency = <50000000>;
	};
};
```

## Documentation/devicetree/bindings/misc/keydebug.txt
```
keydebug driver
=========================

When a system is locked up and unresponsive, a user may long press key to force
reset it. keydebug driver add debug function to collect more information in this
path before system restart.

Collects:
-Top CPU usage tasks
-Call stack of uninterruptible tasks
-Call stack of each online core

Required properties:
- compatible:     must be "keydebug"

- keys_down:      The input key-code used to active debug function count down.
- key_down_delay: The time the input key need to be hold to trigger debug
                  event, value is in milliseconds.
- dbg_fn_delay:   The delay time to active debug function, value is in
                  milliseconds.
Example:
	keydebug {
		compatible = "keydebug";
		key_down_delay = <7000>;
		keys_down = <116>;
		dbg_fn_delay = <2500>;
	}
```

## Documentation/devicetree/bindings/misc/knowles,iaxxx-module-celldrv.txt
```
knowles,iaxxx-module-celldrv.txt
Please add descriptions for the properties of the new node.
```

## Documentation/devicetree/bindings/misc/paintbox.txt
```
* Google Inc. Paintbox Image Processing Unit

Required properties:
- compatible: Should contain "google,paintbox".
- reg: Register base for IPU when on AXI bus
- interrupts: Interrupt line for IPU
- hardware-id: Hardware ID for IPU

Example:
	paintbox@0x60000000 {
		compatible = "google,paintbox";
		reg = <0x0 0x60000000 0x0 0xFFFF >;
		interrupts = <GIC_SPI 168 IRQ_TYPE_LEVEL_HIGH>;
		hardware-id = <0x0 0xb>;
	};
};
```

## Documentation/devicetree/bindings/power/reset/msm-poweroff.txt
```
MSM Restart Driver

A power supply hold (ps-hold) bit is set to power the msm chipsets.
Clearing that bit allows us to restart/poweroff. The difference
between poweroff and restart is determined by unique power manager IC
settings.

Required Properties:
-compatible: "qcom,pshold"
-reg: Specifies the physical address of the ps-hold register

Optional Properties:
-qcom,force-warm-reboot: Issue a warm reboot, even for the traditional cases
				where hard reboot is issued.

-qcom,force-warm-reboot-on-thermal-shutdown: Issue a warm reboot on
				"shutdown,thermal" restart reason.

-qcom,force-warm-reboot-on-reboot-ab-update: Issue a warm reboot on
				"reboot-ab-update" restart reason.

Example:

	restart@fc4ab000 {
		compatible = "qcom,pshold";
		reg = <0xfc4ab000 0x4>;
	};
```

## Documentation/devicetree/bindings/power/supply/google_charger.txt
```
google_charger
~~~~~~~~~~~~~~

Required properties:
 - compatible : "google,charger"
 - google,chg-power-supply: name of the charge control power supply
 - google,bat-power-supply: name of the Fuel Gauge power supply
 - google,chg-update-interval: delay in ms to wait before re-running the work
     item
 - google,chg-battery-capacity: the nominal capacity used to compute the
     effective 1C charge rate
 - google,chg-temp-limits: the temperature buckets limits defining the indexes
     of the constant charge limits (row index in google,chg-cc-limits)
 - google,chg-cv-limits: steps voltage limits (column index in
     google,chg-cc-limits)
 - google,chg-cc-limits: the array of constant current charge rates given in %
     of google,chg-battery-capacity

Optional properties:
 - google,wlc-power-supply: name of wireless charing input power supply
 - google,cv-hw-resolution: the constant voltage setting resolution in micro
     volt defaults to 25000
 - google,cc-hw-resolution: the constant current setting resolution in micro amp
     defaults to 25000
 - google,cv-range-accuracy: the voltage margin in micro volt used at taper to
     determine whether battery voltage should be raised in an attempt to match
     tier voltage for ir drop compensation. Defaults to cv-hw-resolution / 2.
 - google,cv-debounce-cnt: the number of cv-update-interval to wait after
     entering taper or after raising charging voltage for ir drop compensation
     before a new attempt. Defaults to 3 (eg 6 seconds for default
     cv-update-interval).
 - google,cv-update-interval: delay in ms to wait before re-running the work
     item while in taper. Defaults to 2000 (2 seconds)
 - google,cv-tier-ov-delay: the number of cv-update-interval to wait (penalty)
     during ir drop compensation before a new attempt to raise voltage when
     battery voltage is found above tier limit. Defaults to 10 cycles (20
     seconds for default cv-update-interval).
 - google,chg-cc-tolerance: the deci-percent tolerance we need to give the PMIC to
     ensure actual current is below chg-cc-limits (divide by 10 to get
     percentage points). Max allowed tolerance is 25%.
- google,fv-uv-margin-dpct: the deci-percent margin on vtier that charger float
     voltage must not exceed when calculating target voltage during IRDROP
     compensation. Default 0 (disabled), set to 1030 for 3%.
- google,cv-tier-switch-cnt: the number of consecutive poll cyles with current
     under next tier that are needed before switching charge tier.
     Default 3 poll cycles.
```

## Documentation/devicetree/bindings/power/supply/max1720x_battery.txt
```
MAX17201/MAX17205 Fuel Gauge
----------------------------

Required properties :
 - compatible : "maxim,max1720x"

Optional properties :
 - maxim,psy-type-unknown: if set, forces poser supply type to be
   POWER_SUPPLY_TYPE_UNKNOWN rather than POWER_SUPPLY_TYPE_BATTERY

 - io-channels: see Documentation/devicetree/bindings/iio/iio-bindings.txt
 - io-channel-names: see Documentation/devicetree/bindings/iio/iio-bindings.txt
 - maxim,batt-id-range-pct: tolerance in percent on the resitance ID value. if
   not provided, defaults to 20%.
 - maxim,force-batt-id: force battery id (skip detection)
 - maxim,force-hard-reset: force fg hard reset during probe
 - maxim,max1730x-compat: enable experimental support for max17301 fuel gauge

 - maxim,config: node in which children would have a "maxim,batt-id-kohm"
   property and a "maxim,regval" to allow applying configuration changes given a
   battery.
 - maxim,batt-id-kohm: the value of the battery resitance ID the config applies
   to.
 - maxim,n_regval_1720x: An array of u16 that are pairs of register address and
   corresponding values. These values will be written to the shadow registers
   of Maxim fuel gauge their address must be within 0x80 - 0xDF to be considered
 - maxim,r_regval_1720x: An array of u16 that are pairs of register address and
   corresponding values. These values will be written to the ModelGauge m5
   Register their address must be within 0x00 - 0x4D, 0xB0 - 0xDF to be
   considered.
 - maxim,n_regval_1730x: An array of u16 that are pairs of register address and
   corresponding values. These values will be written to the shadow registers
   of Maxim fuel gauge their address must be within 0x80 - 0xEF to be considered
 - maxim,r_regval_1730x: An array of u16 that are pairs of register address and
   corresponding values. These values will be written to the ModelGauge m5
   Register their address must be within 0x00 - 0x4F, 0xA0 - 0xDF to be
   considered.
```

## Documentation/devicetree/bindings/power/supply/overheat_mitigation.txt
```
google,overheat_mitigation
~~~~~~~~~~~~~~

Required properties:
 - compatible : "google,overheat_mitigation"
 - google,begin-mitigation-temp: USB port temperature threshold in decidegrees
     Celsius at which to begin overheat mitigation
 - google,end-mitigation-temp: USB port temperature threshold in decidegrees
     Celsius at which to end overheat mitigation
 - google,port-overheat-work-interval: period in milliseconds at which the
     driver should monitor the overheat status
 - google,polling-freq: the frequency at which the USB connected status should
     be polled (ex. if this is set to 3, check USB status every 3rd work
     interval)

Optional properties:
 - google,accessory-monitoring-period: the length of time in seconds that the
     driver should monitor USB port temperature after a USB accessory is plugged
     in
```
