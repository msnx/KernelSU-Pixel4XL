/*
 * Copyright (c) 2018, The Linux Foundation. All rights reserved.
 *
 * This program is free software; you can redistribute it and/or modify
 * it under the terms of the GNU General Public License version 2 and
 * only version 2 as published by the Free Software Foundation.
 *
 * This program is distributed in the hope that it will be useful,
 * but WITHOUT ANY WARRANTY; without even the implied warranty of
 * MERCHANTABILITY or FITNESS FOR A PARTICULAR PURPOSE.  See the
 * GNU General Public License for more details.
 */

&cam_cci1 {
	/* VD6281 */
	status = "ok";
	vd6281: st,rainbow@20 {
		compatible = "st,rainbow";
		cci-device = <1>;
		cci-master = <1>;
		reg = <0x20>;
		vio-supply = <&max77826_ldo13>;
		vdd-supply = <&max77826_ldo15>;
		regulator-names = "vio", "vdd";
		status = "ok";
	};
};

