
qcom,c1-68k {
	qcom, = <24>;
	/* #3353422_Google_C1SWDCOS_3480mAh_averaged_MasterSlave_Mar23rd2018*/
	qcom,max-voltage-uv = <4400000>;
	qcom,nom-batt-capacity-mah = <3480>;
	qcom,batt-id-kohm = <68>;
	qcom,battery-beta = <4360>;
	qcom,fg-cc-cv-threshold-mv = <4390>;
	qcom,battery-type = "c1-68k";
	qcom,checksum = <0x5417>;
	qcom,gui-version = "PMI8998GUI - 2.0.0.58";
	qcom,fg-profile-data = [
		 95 1E B5 FD
		 CF 02 6D 07
		 C0 1C 4A 02
		 1E 0D 49 0B
		 DD 17 98 23
		 BC 44 0B 5A
		 66 00 00 00
		 11 00 00 00
		 00 00 D8 C2
		 A2 CD 0D A2
		 2A 00 08 00
		 5A DB 25 E5
		 2D 05 D1 01
		 7E 15 0A 00
		 A1 D4 41 2B
		 35 06 09 20
		 27 00 14 00
		 E8 1F 99 05
		 4B 0A 2D FD
		 CE 1C D7 02
		 62 0C BE 0B
		 93 18 AF 23
		 1C 44 D9 5A
		 71 00 00 00
		 0E 00 00 00
		 00 00 6E CC
		 55 C2 89 C2
		 1E 00 00 00
		 06 EA 25 E5
		 3E 06 E1 F3
		 71 F5 6C 02
		 86 02 3C 23
		 C9 33 CC FF
		 07 10 00 00
		 C1 0D 66 46
		 1E 00 40 00
		 A7 01 0A FA
		 FF 00 00 00
		 00 00 00 00
		 00 00 00 00
		 00 00 00 00
		 00 00 00 00
		 00 00 00 00
		 00 00 00 00
		 00 00 00 00
		 00 00 00 00
		 00 00 00 00
		 00 00 00 00
		 00 00 00 00
		 00 00 00 00
		 00 00 00 00
		 00 00 00 00
		 00 00 00 00
		 00 00 00 00
		 00 00 00 00
		 00 00 00 00
	];
};
