/* Copyright (c) 2018, The Linux Foundation. All rights reserved.
 *
 * This program is free software; you can redistribute it and/or modify
 * it under the terms of the GNU General Public License version 2 and
 * only version 2 as published by the Free Software Foundation.
 *
 * This program is distributed in the hope that it will be useful,
 * but WITHOUT ANY WARRANTY; without even the implied warranty of
 * MERCHANTABILITY or FITNESS FOR A PARTICULAR PURPOSE.  See the
 * GNU General Public License for more details.
 */

/*  p9221         PMI855B
 * --------------------------------
 *  QI_INT_ODL -> GPIO02
 *       EN_L  <- GPIO12
 */

&pm8150b_gpios {

	p9221_int_default:p9221_int_default {
		pins = "gpio2";
		function = "normal";
		power-source = <0>;
		drive-open-drain;
		input-enable;
		bias-pull-up;
	};

	gpio_qien_default: gpio_qien_default {
		pins = "gpio12";
		function = "normal";
		power-source = <0>;
		bias-disable;
		output-low;
	};

};

&p9221 {
	status = "ok";
	compatible = "idt,p9221";
	reg = <0x61>;

	pinctrl-names = "default";
	pinctrl-0 = <&gpio_qien_default &p9221_int_default>;

	interrupt-parent = <&spmi_bus>;
	interrupt-names = "p9221_int";
	idt,irq_gpio =<&pm8150b_gpios 2 IRQ_TYPE_NONE>;
	idt,gpio_qien = <&pm8150b_gpios 12 GPIO_ACTIVE_LOW>;
};
