/* Copyright (c) 2018, The Linux Foundation. All rights reserved.
 *
 * This program is free software; you can redistribute it and/or modify
 * it under the terms of the GNU General Public License version 2 and
 * only version 2 as published by the Free Software Foundation.
 *
 * This program is distributed in the hope that it will be useful,
 * but WITHOUT ANY WARRANTY; without even the implied warranty of
 * MERCHANTABILITY or FITNESS FOR A PARTICULAR PURPOSE.  See the
 * GNU General Public License for more details.
 */

// On jaws, audio wants to keep se4 pins active in suspend.
&qupv3_se4_spi {
	pinctrl-1 = <&qupv3_se4_spi_active>;
};

// b/113529207 jaws can only support 400khz on qup 15.
&qupv3_se15_i2c {
	qcom,clk-freq-out = <400000>;
};

