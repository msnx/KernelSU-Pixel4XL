// SPDX-License-Identifier: GPL-2.0
/* Copyright (c) 2019, The Linux Foundation. All rights reserved.
 *
 * This program is free software; you can redistribute it and/or modify
 * it under the terms of the GNU General Public License version 2 and
 * only version 2 as published by the Free Software Foundation.
 *
 * This program is distributed in the hope that it will be useful,
 * but WITHOUT ANY WARRANTY; without even the implied warranty of
 * MERCHANTABILITY or FITNESS FOR A PARTICULAR PURPOSE.  See the
 * GNU General Public License for more details.
 */
&qupv3_se1_spi {
	status = "ok";
	ese: ese@1 {
		compatible = "st,st54j_se";
		reg = <1>;
		spi-max-frequency = <8000000>;
		esereset-gpio = <&tlmm 63 0x00>;
	};
};
