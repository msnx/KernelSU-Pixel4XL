
qcom,c1-180k {
	qcom, = <24>;
	/* #3353407_Google_C1DsyCos_3480mAh_averaged_MasterSlave_Feb27th2018*/
	qcom,max-voltage-uv = <4400000>;
	qcom,nom-batt-capacity-mah = <3480>;
	qcom,batt-id-kohm = <180>;
	qcom,battery-beta = <4360>;
	qcom,fg-cc-cv-threshold-mv = <4390>;
	qcom,battery-type = "c1-180k";
	qcom,checksum = <0xC7C8>;
	qcom,gui-version = "PMI8998GUI - 2.0.0.58";
	qcom,fg-profile-data = [
		 55 1F 05 FC
		 03 0A DD 06
		 E6 1C 7F FB
		 5E 04 0C 0A
		 FA 17 64 23
		 12 45 76 53
		 7D 00 00 00
		 12 00 00 00
		 00 00 B1 C2
		 EB CC 08 B5
		 25 00 08 00
		 11 DA 9B E5
		 3E 05 CA 01
		 C9 15 C6 01
		 1A E5 90 2A
		 34 06 09 20
		 27 00 14 00
		 9E 1F DF 05
		 21 0A B7 06
		 BD 1C 15 03
		 EB 15 37 12
		 8C 18 CA 23
		 EF 4D 23 5B
		 6A 00 00 00
		 0E 00 00 00
		 00 00 F6 07
		 CB C2 65 CB
		 1A 00 00 00
		 C3 E3 9B E5
		 6D FC 05 01
		 ED ED E2 03
		 6F 02 C0 22
		 C6 33 CC FF
		 07 10 00 00
		 C5 0D 66 46
		 1A 00 40 00
		 BC 01 0A FA
		 FF 00 00 00
		 00 00 00 00
		 00 00 00 00
		 00 00 00 00
		 00 00 00 00
		 00 00 00 00
		 00 00 00 00
		 00 00 00 00
		 00 00 00 00
		 00 00 00 00
		 00 00 00 00
		 00 00 00 00
		 00 00 00 00
		 00 00 00 00
		 00 00 00 00
		 00 00 00 00
		 00 00 00 00
		 00 00 00 00
		 00 00 00 00
	];
};
