/* Copyright (c) 2018, The Linux Foundation. All rights reserved.
 *
 * This program is free software; you can redistribute it and/or modify
 * it under the terms of the GNU General Public License version 2 and
 * only version 2 as published by the Free Software Foundation.
 *
 * This program is distributed in the hope that it will be useful,
 * but WITHOUT ANY WARRANTY; without even the implied warranty of
 * MERCHANTABILITY or FITNESS FOR A PARTICULAR PURPOSE.  See the
 * GNU General Public License for more details.
 */

// Configure 1.8v regulator from fingerprint
&pm8150l_l1 {
	regulator-min-microvolt = <1800000>;
	regulator-max-microvolt = <1800000>;
	qcom,init-voltage = <1800000>;
	qcom,init-mode = <RPMH_REGULATOR_MODE_HPM>;
	status = "okay";
};

// Disable floral's default SPI touch port
&floral_spitouch {
	status = "disabled";
};

/* AP Touch SPI CLK is gpio92, CS is gpio93, MISO is gpio94, MOSI is gpio95.
 * Reset gpio130, interrupt gpio118.
 * (???) bus master switch - gpio??
 */

&qupv3_se11_spi {
	status = "ok";
	pinctrl-0 = <>;
	pinctrl-1 = <>;

	touchscreen@0 {
		status = "ok";
		compatible = "st,fts";
		spi-max-frequency = <10000000>;

		reg = <0>;
		interrupt-parent = <&tlmm>;
		interrupts = <118 IRQ_TYPE_LEVEL_LOW>;
		vdd-supply = <&pm8150l_l1>;		// Soli's 1.8v pin
		avdd-supply = <&pm8150_l17>;		// Soli's 3.0v pin

		pinctrl-names = "default", "sleep";
		pinctrl-0 = <&qupv3_se11_spi_active &ts_active_suspend>;
		pinctrl-1 = <&qupv3_se11_spi_active &ts_active_suspend>;

		st,irq-gpio = <&tlmm 118 0>;
		st,reset-gpio = <&tlmm 130 0>;
		// TODO: configure switch
		//st,switch_gpio = <&tlmm 136 0>;
		st,regulator_dvdd = "vdd";
		st,regulator_avdd = "avdd";

		st,firmware_names = "ftm5_fw_pid00c2.ftb",
				    "ftm5_fw_pid00f2.ftb";
		st,limits_names = "stm_fts_production_limits_pid00c2.csv",
				  "stm_fts_production_limits_pid00f2.csv";
		st,panel_map = <&dsi_s6e3hc2_dsc_wqhd_cmd 0>,
			       <&dsi_nt37280_dsc_fhd_cmd 1>;
	};
};

