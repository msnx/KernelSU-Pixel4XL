/* Copyright (c) 2017-2018, The Linux Foundation. All rights reserved.
 *
 * This program is free software; you can redistribute it and/or modify
 * it under the terms of the GNU General Public License version 2 and
 * only version 2 as published by the Free Software Foundation.
 *
 * This program is distributed in the hope that it will be useful,
 * but WITHOUT ANY WARRANTY; without even the implied warranty of
 * MERCHANTABILITY or FITNESS FOR A PARTICULAR PURPOSE.  See the
 * GNU General Public License for more details.
 */

/dts-v1/;
/plugin/;

#include "sm8150-flame-evt.dtsi"

/ {
	model = "Google Inc. MSM sm8150 Flame EVT1.0";
	compatible = "google,floral-sm8150", "qcom,sm8150";
	qcom,msm-id = <339 0x20000>;
	qcom,board-id = <0x060A05 0>;
};
